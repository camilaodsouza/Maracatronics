/*
 * Protocolo de comunicacao
 * [M][ID][Flags][V1][V2][V3][CRCHi][CRCLo]
 * [Flags]=b [XXXX HCCD]
 * recebe do Sumatra [id][XXXX XCCD][V1][V2][V3]
 */

//bibliotecas do radio
#include <Enrf24.h>
#include <nRF24L01.h>
#include <string.h>
#include <SPI.h>

#define PROTOCOL_SIZE 6
#define START_BYTE 0x4D

#define Led_Aux PF_0

#define HORUS_BIT 0x08
#define CHANNEL 10



 const byte _auchCRCHi[] = {
    0x00, 0xC1, 0x81, 0x40, 0x01, 0xC0, 0x80, 0x41, 0x01, 0xC0, 0x80, 0x41, 0x00, 0xC1, 0x81,
 0x40, 0x01, 0xC0, 0x80, 0x41, 0x00, 0xC1, 0x81, 0x40, 0x00, 0xC1, 0x81, 0x40, 0x01, 0xC0,
  0x80, 0x41, 0x01, 0xC0, 0x80, 0x41, 0x00, 0xC1, 0x81, 0x40, 0x00, 0xC1, 0x81, 0x40, 0x01,
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  0x00, 0xC1, 0x81, 0x40, 0x01, 0xC0, 0x80, 0x41, 0x01, 0xC0, 0x80, 0x41, 0x00, 0xC1, 0x81,
  0x40};

/* Table of CRC values for low�order byte */
const byte _auchCRCLo[] = {
    0x00, 0xC0, 0xC1, 0x01, 0xC3, 0x03, 0x02, 0xC2, 0xC6, 0x06, 0x07, 0xC7, 0x05, 0xC5, 0xC4,
  0x04, 0xCC, 0x0C, 0x0D, 0xCD, 0x0F, 0xCF, 0xCE, 0x0E, 0x0A, 0xCA, 0xCB, 0x0B, 0xC9, 0x09,
  0x08, 0xC8, 0xD8, 0x18, 0x19, 0xD9, 0x1B, 0xDB, 0xDA, 0x1A, 0x1E, 0xDE, 0xDF, 0x1F, 0xDD,
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  0x44, 0x84, 0x85, 0x45, 0x87, 0x47, 0x46, 0x86, 0x82, 0x42, 0x43, 0x83, 0x41, 0x81, 0x80,
  0x40};



Enrf24 radio(PD_1, PC_4, PC_5); //PD_1: CE   PC_4: CSN   PC_5:IRQ
const uint8_t txaddr[] = {0x11, 0x22, 0x33, 0x44, 0x55};



byte protocol[PROTOCOL_SIZE];
const int number_of_bytes=PROTOCOL_SIZE+2;
int i=0, timer=0;
unsigned long horus_timer=0;
boolean state = false,horus_bit=false, prev_horus_bit=false;




void Status_do_radio_serial(uint8_t status);
void enviar_pacote (byte* frame);
word calcCrc(byte address, byte* pduFrame, byte pduLen);




void setup()
{
  pinMode(RED_LED, OUTPUT);
  pinMode(BLUE_LED, OUTPUT);
  pinMode(GREEN_LED, OUTPUT);

  Serial.begin(38400);

  SPI.begin();
  SPI.setDataMode(SPI_MODE0);
  SPI.setBitOrder(MSBFIRST);           //MSB primeiro
  SPI.setModule(3);         //seleciona o modulo de SPI 3 do micro
  
  radio.begin();  //padrões 1Mbps, canal 0, max TX power
  Status_do_radio_serial(radio.radioState());


  radio.setChannel(CHANNEL);
  radio.setTXaddress((void*)txaddr);

  horus_timer=millis();
}

void loop()
{

  if(horus_timer-millis()>=250){
    horus_bit=!horus_bit;
  }

  if (radio.radioState() == ENRF24_STATE_NOTPRESENT) {
    Serial.println("erro no radio");
    digitalWrite(GREEN_LED, LOW);
    digitalWrite(BLUE_LED, LOW);
    digitalWrite(RED_LED, HIGH);
  }

  else {

    if (Serial.available()) {

      digitalWrite(BLUE_LED, LOW);
      digitalWrite(RED_LED, LOW);

      char a = Serial.read();
      if(a==0){
        a=1;
      }
      protocol[i] = a;
      
      if (protocol[0]==START_BYTE){
        i++;
      }
      timer = 0;
      
      

      if (i >= PROTOCOL_SIZE)
      {
//        for(int j=0;j<PROTOCOL_SIZE;j++){
//          Serial.write(&protocol[j],1);
//        }
        enviar_pacote(protocol);
        i = 0;
        state=!state;
        digitalWrite(GREEN_LED, state);
      }
    }//end if do serial available

    else {
      digitalWrite(RED_LED, LOW);

      if (timer <= 1000){
        timer++;
      }
      else{
        digitalWrite(BLUE_LED, HIGH);
        digitalWrite(GREEN_LED, LOW);
      }
    }

  }//end else do estado do radio

} //end loop




void enviar_pacote (byte* frame){
        byte protocol_aux[PROTOCOL_SIZE-2];
        char send_frame [number_of_bytes];
        
         
        
        //Montar o frame de envio
        send_frame[0]=frame[0];           //START byte M
        send_frame[1]=frame[1];    //ID do Robo

        for(int j=0;j<PROTOCOL_SIZE-2;j++){
          protocol_aux[j]=frame[j+2];
          send_frame[j+2]=protocol_aux[j];
        }


        if(horus_bit!=prev_horus_bit){
         // send_frame[2]=send_frame[2]|HORUS_BIT;
          prev_horus_bit=horus_bit;
        }

        u_int crc=calcCrc(frame[1],protocol_aux,PROTOCOL_SIZE-1);
        byte crclo=crc&0xFF;
        byte crchi=(crc>>8)&0xFF;

        send_frame[number_of_bytes-2]=crchi;
        send_frame[number_of_bytes-1]=crclo;


          for(int j=0;j<number_of_bytes;j++){
          Serial.write(&send_frame[j],1);
        }




        //enviar o frame
        radio.print(send_frame);
        radio.flush();
        delay(5);
        
}


word calcCrc(byte address, byte* pduFrame, byte pduLen) {
    byte CRCHi = 0xFF, CRCLo = 0x0FF, Index;

    Index = CRCHi ^ address;
    CRCHi = CRCLo ^ _auchCRCHi[Index];
    CRCLo = _auchCRCLo[Index];

    while (pduLen--) {
      Index = CRCHi ^ *pduFrame++;
      CRCHi = CRCLo ^ _auchCRCHi[Index];
      CRCLo = _auchCRCLo[Index];
    }

    return (CRCHi << 8) | CRCLo;
  }


void Status_do_radio_serial(uint8_t status)
{
  Serial.print("Enrf24 radio transceiver status: ");
  switch (status) {
    case ENRF24_STATE_NOTPRESENT:
      Serial.println("NO TRANSCEIVER PRESENT");
      break;

    case ENRF24_STATE_DEEPSLEEP:
      Serial.println("DEEP SLEEP <1uA power consumption");
      break;

    case ENRF24_STATE_IDLE:
      Serial.println("IDLE module powered up w/ oscillators running");
      break;

    case ENRF24_STATE_PTX:
      Serial.println("Actively Transmitting");
      break;

    case ENRF24_STATE_PRX:
      Serial.println("Receive Mode");
      break;

    default:
      Serial.println("UNKNOWN STATUS CODE");
  }
}

